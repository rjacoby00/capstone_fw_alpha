## app/Kconfig
```kconfig
# Copyright (c) 2025 Ryan Jacoby
# SPDX-License-Identifier: Apache-2.0
#

menu "FW Alpha"
source "Kconfig.zephyr"
endmenu
```

## boards/haashooligans/hw_alpha/Kconfig.defconfig
```kconfig
# Copyright (c) 2025 Ryan Jacoby
# SPDX-License-Identifier: Apache-2.0
#

if BOARD_HW_ALPHA

# Ethernet config boilerplate; needs to be updated with dual Ethernet/WiFi
# config options.
if NETWORKING

config NET_L2_ETHERNET
	default y

endif # NETWORKING

endif # BOARD_HW_ALPHA
```

## boards/haashooligans/hw_alpha/Kconfig.hw_alpha
```kconfig
# Copyright (c) 2025 Ryan Jacoby
# SPDX-License-Identifier: Apache-2.0
#

config BOARD_HW_ALPHA
	select SOC_STM32F767XX
```

## boards/haashooligans/hw_alpha/board.yml
```yaml
# Copyright (c) 2025 Ryan Jacoby
# SPDX-License-Identifier: Apache-2.0
#

board:
  name: hw_alpha
  vendor: haashooligans
  socs:
    - name: stm32f767xx
```

## west.yml
```yaml
# Copyright (c) 2025 Ryan Jacoby
# SPDX-License-Identifier: Apache-2.0
#

manifest:
  remotes:
    - name: zephyrproject-rtos
      url-base: https://github.com/zephyrproject-rtos

  projects:
    - name: zephyr
      remote: zephyrproject-rtos
      revision: main
      import:
        name-allowlist:
          - cmsis
          - cmsis-dsp
          - hal_stm32
          - nrf_wifi
          - picolibc
    - name: net-tools
      path: tools/net-tools

  self:
    path: fw_alpha
```
